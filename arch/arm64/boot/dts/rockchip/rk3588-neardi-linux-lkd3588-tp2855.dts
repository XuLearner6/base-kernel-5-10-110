// SPDX-License-Identifier: (GPL-2.0+ OR MIT)
/*
 * Copyright (c) 2021 Rockchip Electronics Co., Ltd.
 *
 */

/dts-v1/;

#include "rk3588-neardi-linux-ld160-x0.dtsi"
#include "rk3588-linux.dtsi"
//#include "rk3588-neardi-linux-ld160-mipi2lvds.dtsi" //vp3
//#include "rk3588-neardi-linux-ld160-mipi2lvds-EV101WXM-N10.dtsi" //vp3
//#include "rk3588-neardi-linux-ld160-mipi2hdmi.dtsi" //vp3
//#include "rk3588-neardi-linux-ld160-dp.dtsi"  //vp2
#include "rk3588-neardi-linux-ld160-hdmi.dtsi" //vp0/1
//#include "rk3588-neardi-linux-ld160-typec2dp.dtsi" 
//#include "rk3588-neardi-linux-ld160-hdmiin.dtsi" 
//#include "rk3588-neardi-linux-ld160-n4.dtsi" 
//#include "rk3588-neardi-linux-ld160-ov48c40.dtsi" 
//#include "rk3588-neardi-linux-ld160-lj160.dtsi" 
#include "rk3588-neardi-linux-ld160-tp2855-dphy0.dtsi"  //dphy0
//#include "rk3588-neardi-linux-ld160-ov13855-os04a10-dphy1.dtsi"  //dphy1
/ {
	model = "Rockchip RK3588 NEARDI LKD3588 Board";
	compatible = "rockchip,rk3588-linux", "rockchip,rk3588";
};
