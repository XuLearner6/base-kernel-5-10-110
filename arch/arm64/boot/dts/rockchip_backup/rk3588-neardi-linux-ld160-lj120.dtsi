// SPDX-License-Identifier: (GPL-2.0+ OR MIT)
/*
 * Copyright (c) 2020 Rockchip Electronics Co., Ltd.
 *
 */

 /*
 * lj160 uart4/uart7/uart9/can0/can1/sardc/  form main board,so configure on  the main board  dtsi
 *
 */

/ {
/delete-node/ gpio-export;
};

&aw9523_gpio{
			compatible = "awinic,awinic-gpio";
			shield-switch=<1>;
};

&es8388_sound{
			spk-con-gpio = <&gpio4 RK_PA0 GPIO_ACTIVE_LOW>;
};